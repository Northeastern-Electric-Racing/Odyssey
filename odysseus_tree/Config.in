## odysseus_tree/Config.in
```kconfig
source "$BR2_EXTERNAL_ODY_TREE_PATH/package/nrc/Config.in"
source "$BR2_EXTERNAL_ODY_TREE_PATH/package/nrc7292/Config.in"
source "$BR2_EXTERNAL_ODY_TREE_PATH/package/nrc7394/Config.in"
source "$BR2_EXTERNAL_ODY_TREE_PATH/package/nrc-cli/Config.in"
source "$BR2_EXTERNAL_ODY_TREE_PATH/package/nrc-init-extra/Config.in"
source "$BR2_EXTERNAL_ODY_TREE_PATH/package/alfa-led/Config.in"
source "$BR2_EXTERNAL_ODY_TREE_PATH/package/nanomq/Config.in"
source "$BR2_EXTERNAL_ODY_TREE_PATH/package/auto-modloader/Config.in"
source "$BR2_EXTERNAL_ODY_TREE_PATH/package/rpi-dtloader/Config.in"
source "$BR2_EXTERNAL_ODY_TREE_PATH/package/nero2/Config.in"
source "$BR2_EXTERNAL_ODY_TREE_PATH/package/nerqt6/Config.in"
source "$BR2_EXTERNAL_ODY_TREE_PATH/package/calypso/Config.in"
source "$BR2_EXTERNAL_ODY_TREE_PATH/package/nermosquitto/Config.in"
source "$BR2_EXTERNAL_ODY_TREE_PATH/package/mqttui/Config.in"
source "$BR2_EXTERNAL_ODY_TREE_PATH/package/rpi-utils/Config.in"
source "$BR2_EXTERNAL_ODY_TREE_PATH/package/usbip/Config.in"
source "$BR2_EXTERNAL_ODY_TREE_PATH/package/python-gmqtt/Config.in"
source "$BR2_EXTERNAL_ODY_TREE_PATH/package/tpu-telemetry/Config.in"
source "$BR2_EXTERNAL_ODY_TREE_PATH/package/odysseus-daemon/Config.in"
```

## odysseus_tree/configs/raspberrypi4_64_ap_defconfig
```kconfig
BR2_aarch64=y
BR2_cortex_a72=y
BR2_ARM_FPU_VFPV4=y
BR2_TOOLCHAIN_EXTERNAL=y
BR2_CCACHE=y
BR2_GLOBAL_PATCH_DIR="$(BR2_EXTERNAL_ODY_TREE_PATH)/patches board/raspberrypi/patches"
BR2_PER_PACKAGE_DIRECTORIES=y
BR2_TARGET_GENERIC_HOSTNAME="raspberrypi-ap"
BR2_ROOTFS_DEVICE_CREATION_DYNAMIC_EUDEV=y
BR2_TARGET_GENERIC_ROOT_PASSWD="$(ODY_AP_ROOT_PASSWORD)"
# BR2_TARGET_GENERIC_GETTY is not set
BR2_TARGET_TZ_INFO=y
BR2_TARGET_LOCALTIME="America/New_York"
BR2_ROOTFS_OVERLAY="$(BR2_EXTERNAL_ODY_TREE_PATH)/overlays/rootfs_overlay_common $(BR2_EXTERNAL_ODY_TREE_PATH)/overlays/rootfs_overlay_nrc_common $(BR2_EXTERNAL_ODY_TREE_PATH)/overlays/rootfs_overlay_ap"
BR2_ROOTFS_POST_BUILD_SCRIPT="$(BR2_EXTERNAL_ODY_TREE_PATH)/post-build-ap.sh $(BR2_EXTERNAL_ODY_TREE_PATH)/post-build-os-release.sh board/raspberrypi4-64/post-build.sh"
BR2_ROOTFS_POST_IMAGE_SCRIPT="board/raspberrypi4-64/post-image.sh"
BR2_ROOTFS_POST_SCRIPT_ARGS="AP"
BR2_LINUX_KERNEL=y
BR2_LINUX_KERNEL_CUSTOM_TARBALL=y
BR2_LINUX_KERNEL_CUSTOM_TARBALL_LOCATION="$(call github,raspberrypi,linux,576cc10e1ed50a9eacffc7a05c796051d7343ea4)/linux-576cc10e1ed50a9eacffc7a05c796051d7343ea4.tar.gz"
BR2_LINUX_KERNEL_DEFCONFIG="bcm2711"
BR2_LINUX_KERNEL_DTS_SUPPORT=y
BR2_LINUX_KERNEL_INTREE_DTS_NAME="broadcom/bcm2711-rpi-4-b broadcom/bcm2711-rpi-400 broadcom/bcm2711-rpi-cm4 broadcom/bcm2711-rpi-cm4s"
BR2_LINUX_KERNEL_NEEDS_HOST_OPENSSL=y
BR2_PACKAGE_LINUX_TOOLS_GPIO=y
BR2_PACKAGE_BUSYBOX_SHOW_OTHERS=y
BR2_PACKAGE_XZ=y
BR2_PACKAGE_ZSTD=y
BR2_PACKAGE_GIT=y
BR2_PACKAGE_E2FSPROGS=y
BR2_PACKAGE_E2FSPROGS_RESIZE2FS=y
BR2_PACKAGE_RPI_FIRMWARE=y
BR2_PACKAGE_RPI_FIRMWARE_BOOTCODE_BIN=y
BR2_PACKAGE_RPI_FIRMWARE_VARIANT_PI4=y
BR2_PACKAGE_RPI_FIRMWARE_CONFIG_FILE="$(BR2_EXTERNAL_ODY_TREE_PATH)/board/ap/config-pi4.txt"
BR2_PACKAGE_RPI_FIRMWARE_CMDLINE_FILE="$(BR2_EXTERNAL_ODY_TREE_PATH)/board/ap/cmdline.txt"
BR2_PACKAGE_LM_SENSORS=y
BR2_PACKAGE_RASPI_GPIO=y
BR2_PACKAGE_PYTHON3=y
BR2_PACKAGE_CA_CERTIFICATES=y
BR2_PACKAGE_OPENSSL=y
BR2_PACKAGE_LIBQMI=y
BR2_PACKAGE_LIBCURL=y
BR2_PACKAGE_BMON=y
BR2_PACKAGE_CHRONY=y
BR2_PACKAGE_DHCPCD=y
BR2_PACKAGE_DROPBEAR=y
BR2_PACKAGE_GESFTPSERVER=y
BR2_PACKAGE_HOSTAPD=y
# BR2_PACKAGE_IFUPDOWN_SCRIPTS is not set
BR2_PACKAGE_IPERF3=y
BR2_PACKAGE_IPROUTE2=y
BR2_PACKAGE_IPUTILS=y
BR2_PACKAGE_IW=y
BR2_PACKAGE_UQMI=y
BR2_PACKAGE_WIRELESS_REGDB=y
BR2_PACKAGE_DOCKER_CLI=y
BR2_PACKAGE_DOCKER_COMPOSE=y
BR2_PACKAGE_DOCKER_ENGINE=y
BR2_PACKAGE_HTOP=y
BR2_PACKAGE_KMOD_TOOLS=y
BR2_PACKAGE_NANO=y
BR2_TARGET_ROOTFS_EXT2=y
BR2_TARGET_ROOTFS_EXT2_4=y
BR2_TARGET_ROOTFS_EXT2_SIZE="2G"
# BR2_TARGET_ROOTFS_TAR is not set
BR2_PACKAGE_HOST_DOSFSTOOLS=y
BR2_PACKAGE_HOST_GENIMAGE=y
BR2_PACKAGE_HOST_KMOD_XZ=y
BR2_PACKAGE_HOST_MTOOLS=y
BR2_PACKAGE_NRC7292=y
BR2_PACKAGE_NRC7292_CUSTOM_BD_FILE="$(BR2_EXTERNAL_ODY_TREE_PATH)/package/nrc7292/nrc7292_alfa_bd.dat"
BR2_PACKAGE_NRC_CLI=y
BR2_PACKAGE_NRC_INIT_EXTRA=y
BR2_PACKAGE_ALFA_LED=y
BR2_PACKAGE_ALFA_LED_AP=y
BR2_PACKAGE_RPI_DTLOADER=y
BR2_PACKAGE_RPI_DTLOADER_FILES="$(BR2_EXTERNAL_ODY_TREE_PATH)/package/nrc7292/newracom_for_5-16_or_later.dts"
BR2_PACKAGE_USBIP=y
```

## odysseus_tree/configs/raspberrypi4_64_tpu_defconfig
```kconfig
BR2_aarch64=y
BR2_cortex_a72=y
BR2_ARM_FPU_VFPV4=y
BR2_TOOLCHAIN_EXTERNAL=y
BR2_CCACHE=y
BR2_GLOBAL_PATCH_DIR="$(BR2_EXTERNAL_ODY_TREE_PATH)/patches board/raspberrypi/patches"
BR2_PER_PACKAGE_DIRECTORIES=y
BR2_TARGET_GENERIC_HOSTNAME="raspberrypi-sta"
BR2_ROOTFS_DEVICE_CREATION_DYNAMIC_EUDEV=y
BR2_TARGET_GENERIC_ROOT_PASSWD="$(ODY_TPU_ROOT_PASSWORD)"
# BR2_TARGET_GENERIC_GETTY is not set
BR2_TARGET_TZ_INFO=y
BR2_TARGET_LOCALTIME="America/New_York"
BR2_ROOTFS_OVERLAY="$(BR2_EXTERNAL_ODY_TREE_PATH)/overlays/rootfs_overlay_common $(BR2_EXTERNAL_ODY_TREE_PATH)/overlays/rootfs_overlay_nrc_common $(BR2_EXTERNAL_ODY_TREE_PATH)/overlays/rootfs_overlay_tpu"
BR2_ROOTFS_POST_BUILD_SCRIPT="$(BR2_EXTERNAL_ODY_TREE_PATH)/post-build-sta.sh $(BR2_EXTERNAL_ODY_TREE_PATH)/post-build-os-release.sh $(BR2_EXTERNAL_ODY_TREE_PATH)/post-build-base-connect.sh board/raspberrypi4-64/post-build.sh"
BR2_ROOTFS_POST_IMAGE_SCRIPT="board/raspberrypi4-64/post-image.sh"
BR2_ROOTFS_POST_SCRIPT_ARGS="TPU"
BR2_LINUX_KERNEL=y
BR2_LINUX_KERNEL_CUSTOM_TARBALL=y
BR2_LINUX_KERNEL_CUSTOM_TARBALL_LOCATION="$(call github,raspberrypi,linux,576cc10e1ed50a9eacffc7a05c796051d7343ea4)/linux-576cc10e1ed50a9eacffc7a05c796051d7343ea4.tar.gz"
BR2_LINUX_KERNEL_DEFCONFIG="bcm2711"
BR2_LINUX_KERNEL_DTS_SUPPORT=y
BR2_LINUX_KERNEL_INTREE_DTS_NAME="broadcom/bcm2711-rpi-4-b broadcom/bcm2711-rpi-400 broadcom/bcm2711-rpi-cm4 broadcom/bcm2711-rpi-cm4s"
BR2_LINUX_KERNEL_NEEDS_HOST_OPENSSL=y
BR2_PACKAGE_LINUX_TOOLS_GPIO=y
BR2_PACKAGE_BUSYBOX_SHOW_OTHERS=y
BR2_PACKAGE_ALSA_UTILS=y
BR2_PACKAGE_ALSA_UTILS_APLAY=y
BR2_PACKAGE_ALSA_UTILS_SPEAKER_TEST=y
BR2_PACKAGE_FFMPEG=y
BR2_PACKAGE_FFMPEG_NONFREE=y
BR2_PACKAGE_FFMPEG_FFPLAY=y
BR2_PACKAGE_FFMPEG_FFPROBE=y
BR2_PACKAGE_XZ=y
BR2_PACKAGE_ZSTD=y
BR2_PACKAGE_GIT=y
BR2_PACKAGE_E2FSPROGS=y
BR2_PACKAGE_E2FSPROGS_RESIZE2FS=y
BR2_PACKAGE_DEJAVU=y
# BR2_PACKAGE_DEJAVU_SANS is not set
# BR2_PACKAGE_DEJAVU_SERIF is not set
# BR2_PACKAGE_DEJAVU_SANS_CONDENSED is not set
# BR2_PACKAGE_DEJAVU_SERIF_CONDENSED is not set
BR2_PACKAGE_KMSCUBE=y
BR2_PACKAGE_MESA3D=y
BR2_PACKAGE_MESA3D_GALLIUM_DRIVER_V3D=y
BR2_PACKAGE_MESA3D_OPENGL_ES=y
BR2_PACKAGE_PSPLASH=y
BR2_PACKAGE_PSPLASH_IMAGE="$(BR2_EXTERNAL_ODY_TREE_PATH)/board/tpu/ner-logo-dark.png"
BR2_PACKAGE_BRCMFMAC_SDIO_FIRMWARE_RPI=y
BR2_PACKAGE_BRCMFMAC_SDIO_FIRMWARE_RPI_BT=y
BR2_PACKAGE_BRCMFMAC_SDIO_FIRMWARE_RPI_WIFI=y
BR2_PACKAGE_RPI_FIRMWARE=y
BR2_PACKAGE_RPI_FIRMWARE_VARIANT_PI4=y
BR2_PACKAGE_RPI_FIRMWARE_CONFIG_FILE="$(BR2_EXTERNAL_ODY_TREE_PATH)/board/tpu/config.txt"
BR2_PACKAGE_RPI_FIRMWARE_CMDLINE_FILE="$(BR2_EXTERNAL_ODY_TREE_PATH)/board/tpu/cmdline.txt"
BR2_PACKAGE_GPSD=y
BR2_PACKAGE_GPSD_DEVICES="/dev/ttyAMA5 /dev/pps0"
BR2_PACKAGE_GPSD_UBX=y
BR2_PACKAGE_GPSD_PYTHON=y
BR2_PACKAGE_LM_SENSORS=y
BR2_PACKAGE_MINICOM=y
BR2_PACKAGE_PPS_TOOLS=y
BR2_PACKAGE_RASPI_GPIO=y
BR2_PACKAGE_PYTHON_SERIAL=y
# BR2_PACKAGE_ALSA_LIB_RAWMIDI is not set
BR2_PACKAGE_CA_CERTIFICATES=y
BR2_PACKAGE_OPENSSL=y
BR2_PACKAGE_PIXMAN=y
BR2_PACKAGE_DTC=y
BR2_PACKAGE_DTC_PROGRAMS=y
BR2_PACKAGE_LIBCURL=y
# BR2_PACKAGE_LIBCURL_COOKIES_SUPPORT is not set
# BR2_PACKAGE_LIBCURL_EXTRA_PROTOCOLS_FEATURES is not set
BR2_PACKAGE_BMON=y
BR2_PACKAGE_CAN_UTILS=y
BR2_PACKAGE_CHRONY=y
BR2_PACKAGE_DHCPCD=y
BR2_PACKAGE_DROPBEAR=y
BR2_PACKAGE_GESFTPSERVER=y
# BR2_PACKAGE_IFUPDOWN_SCRIPTS is not set
BR2_PACKAGE_IPERF3=y
BR2_PACKAGE_IPROUTE2=y
BR2_PACKAGE_IPUTILS=y
BR2_PACKAGE_IW=y
BR2_PACKAGE_LINPHONE=y
BR2_PACKAGE_WIRELESS_REGDB=y
BR2_PACKAGE_WPA_SUPPLICANT=y
BR2_PACKAGE_WPA_SUPPLICANT_DEBUG_SYSLOG=y
BR2_PACKAGE_WPA_SUPPLICANT_CLI=y
BR2_PACKAGE_WPA_SUPPLICANT_PASSPHRASE=y
BR2_PACKAGE_DOCKER_CLI=y
BR2_PACKAGE_DOCKER_COMPOSE=y
BR2_PACKAGE_DOCKER_ENGINE=y
BR2_PACKAGE_HTOP=y
BR2_PACKAGE_KMOD_TOOLS=y
BR2_PACKAGE_NANO=y
BR2_TARGET_ROOTFS_EXT2=y
BR2_TARGET_ROOTFS_EXT2_4=y
BR2_TARGET_ROOTFS_EXT2_SIZE="4G"
# BR2_TARGET_ROOTFS_TAR is not set
BR2_PACKAGE_HOST_DOSFSTOOLS=y
BR2_PACKAGE_HOST_GENIMAGE=y
BR2_PACKAGE_HOST_GO_BIN=y
BR2_PACKAGE_HOST_KMOD_XZ=y
BR2_PACKAGE_HOST_MTOOLS=y
BR2_PACKAGE_HOST_PYTHON3=y
BR2_PACKAGE_NRC7292=y
BR2_PACKAGE_NRC7292_CUSTOM_BD_FILE="$(BR2_EXTERNAL_ODY_TREE_PATH)/package/nrc7292/nrc7292_alfa_bd.dat"
BR2_PACKAGE_NRC_CLI=y
BR2_PACKAGE_NRC_INIT_EXTRA=y
BR2_PACKAGE_ALFA_LED=y
BR2_PACKAGE_NANOMQ=y
BR2_PACKAGE_NANOMQ_QUIC=y
BR2_PACKAGE_NANOMQ_BENCH=y
BR2_PACKAGE_NANOMQ_SQLITE=y
BR2_PACKAGE_NANOMQ_DISABLE_SHAREDLIB=y
BR2_PACKAGE_NANOMQ_RULE_ENGINE=y
BR2_PACKAGE_NANOMQ_PLUGIN=y
BR2_PACKAGE_NANOMQ_PLUGIN_LIST="$(BR2_EXTERNAL_ODY_TREE_PATH)/board/tpu/plugin_user_property_timestamp.c"
BR2_PACKAGE_RPI_DTLOADER=y
BR2_PACKAGE_RPI_DTLOADER_FILES="$(BR2_EXTERNAL_ODY_TREE_PATH)/board/tpu/newracom_for_5-16_or_later.dts $(BR2_EXTERNAL_ODY_TREE_PATH)/board/tpu/mcp2515-can0-spi4.dts $(BR2_EXTERNAL_ODY_TREE_PATH)/board/tpu/mmc_spi-spi1.dts"
BR2_PACKAGE_NERO2=y
BR2_PACKAGE_NERQT6=y
BR2_PACKAGE_NERQT6BASE_EGLFS=y
BR2_PACKAGE_NERQT6BASE_DEFAULT_QPA="eglfs"
BR2_PACKAGE_NERQT6BASE_JPEG=y
BR2_PACKAGE_NERQT6BASE_PNG=y
BR2_PACKAGE_NERQT6BASE_WIDGETS=y
BR2_PACKAGE_NERQT6BASE_NETWORK=y
BR2_PACKAGE_NERQT6BASE_SYSLOG=y
BR2_PACKAGE_NERQT6CORE5COMPAT=y
BR2_PACKAGE_NERQT6SVG=y
BR2_PACKAGE_NERQT6DECLARATIVE=y
BR2_PACKAGE_NERQT6DECLARATIVE_QUICK=y
BR2_PACKAGE_NERQT6MQTT=y
BR2_PACKAGE_NERQT6GRPC=y
BR2_PACKAGE_NERQT6CHARTS=y
BR2_PACKAGE_CALYPSO=y
BR2_PACKAGE_NERMOSQUITTO=y
BR2_PACKAGE_NERMOSQUITTO_PLUGIN_LIST="$(BR2_EXTERNAL_ODY_TREE_PATH)/board/tpu/mosquitto_message_timestamp.c"
BR2_PACKAGE_MQTTUI=y
BR2_PACKAGE_RPI_UTILS=y
BR2_PACKAGE_RPI_UTILS_PINCTRL=y
BR2_PACKAGE_USBIP=y
BR2_PACKAGE_TPU_TELEMETRY=y
BR2_PACKAGE_ODYSSEUS_DAEMON=y
```

## odysseus_tree/package/odysseus-daemon/Config.in
```kconfig
config BR2_PACKAGE_ODYSSEUS_DAEMON
    bool "odysseus daemon"
    depends on BR2_PACKAGE_HOST_RUSTC_TARGET_ARCH_SUPPORTS
    depends on BR2_PACKAGE_OPENSSL
    select BR2_PACKAGE_HOST_RUSTC
    help
        The Odysseus daemon manager, made for the TPU build.
        
        Written in Rust, utilizing MQTT and other libs.
        
        https://github.com/Northeastern-Electric-Racing/Odysseus-Daemon
```
